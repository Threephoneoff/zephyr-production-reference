## boards/custom/zephyr_logger/board.yml
```yaml
board:
  name: zephyr_logger
  full_name: Zephyr Logger
  vendor: custom
  socs:
    - name: stm32h7b3xx
```

## build/Kconfig/Kconfig.shield.defconfig
```kconfig
osource "/Users/denislavtrifonov/work/projects/zephyr-data-logger/zephyr-production-reference/boards/shields/*/Kconfig.defconfig"
```

## build/Kconfig/arch/Kconfig
```kconfig
# Load Zephyr Arch Kconfig descriptions.
osource "/Users/denislavtrifonov/work/projects/zephyr-data-logger/zephyr/arch/rx/Kconfig"
osource "/Users/denislavtrifonov/work/projects/zephyr-data-logger/zephyr/arch/x86/Kconfig"
osource "/Users/denislavtrifonov/work/projects/zephyr-data-logger/zephyr/arch/xtensa/Kconfig"
osource "/Users/denislavtrifonov/work/projects/zephyr-data-logger/zephyr/arch/sparc/Kconfig"
osource "/Users/denislavtrifonov/work/projects/zephyr-data-logger/zephyr/arch/riscv/Kconfig"
osource "/Users/denislavtrifonov/work/projects/zephyr-data-logger/zephyr/arch/posix/Kconfig"
osource "/Users/denislavtrifonov/work/projects/zephyr-data-logger/zephyr/arch/openrisc/Kconfig"
osource "/Users/denislavtrifonov/work/projects/zephyr-data-logger/zephyr/arch/mips/Kconfig"
osource "/Users/denislavtrifonov/work/projects/zephyr-data-logger/zephyr/arch/arm64/Kconfig"
osource "/Users/denislavtrifonov/work/projects/zephyr-data-logger/zephyr/arch/arm/Kconfig"
osource "/Users/denislavtrifonov/work/projects/zephyr-data-logger/zephyr/arch/arc/Kconfig"
```

## build/Kconfig/boards/Kconfig.defconfig.tmp
```kconfig
# Load Zephyr board defconfig descriptions.
osource "/Users/denislavtrifonov/work/projects/zephyr-data-logger/zephyr-production-reference/boards/custom/zephyr_logger/Kconfig.defconfig"
```

## build/Kconfig/boards/Kconfig.zephyr_logger
```kconfig
# Load board Kconfig descriptions.
osource "/Users/denislavtrifonov/work/projects/zephyr-data-logger/zephyr-production-reference/boards/custom/zephyr_logger/Kconfig.zephyr_logger"
```

## build/Kconfig/soc/Kconfig
```kconfig
# Load Zephyr SoC Kconfig descriptions.
osource "/Users/denislavtrifonov/work/projects/zephyr-data-logger/zephyr/soc/xlnx/zynqmp/Kconfig"
osource "/Users/denislavtrifonov/work/projects/zephyr-data-logger/zephyr/soc/xlnx/zynq7000/Kconfig"
osource "/Users/denislavtrifonov/work/projects/zephyr-data-logger/zephyr/soc/xlnx/versalnet/Kconfig"
osource "/Users/denislavtrifonov/work/projects/zephyr-data-logger/zephyr/soc/xlnx/versal2/Kconfig"
osource "/Users/denislavtrifonov/work/projects/zephyr-data-logger/zephyr/soc/xlnx/versal/Kconfig"
osource "/Users/denislavtrifonov/work/projects/zephyr-data-logger/zephyr/soc/xen/Kconfig"
osource "/Users/denislavtrifonov/work/projects/zephyr-data-logger/zephyr/soc/wch/ch32v/Kconfig"
osource "/Users/denislavtrifonov/work/projects/zephyr-data-logger/zephyr/soc/ti/simplelink/Kconfig"
osource "/Users/denislavtrifonov/work/projects/zephyr-data-logger/zephyr/soc/ti/mspm0/Kconfig"
osource "/Users/denislavtrifonov/work/projects/zephyr-data-logger/zephyr/soc/ti/lm3s6965/Kconfig"
osource "/Users/denislavtrifonov/work/projects/zephyr-data-logger/zephyr/soc/ti/k3/Kconfig"
osource "/Users/denislavtrifonov/work/projects/zephyr-data-logger/zephyr/soc/telink/tlsr/Kconfig"
osource "/Users/denislavtrifonov/work/projects/zephyr-data-logger/zephyr/soc/syna/sr100/Kconfig"
osource "/Users/denislavtrifonov/work/projects/zephyr-data-logger/zephyr/soc/starfive/jh71xx/Kconfig"
osource "/Users/denislavtrifonov/work/projects/zephyr-data-logger/zephyr/soc/st/stm32/Kconfig"
osource "/Users/denislavtrifonov/work/projects/zephyr-data-logger/zephyr/soc/snps/qemu_arc/Kconfig"
osource "/Users/denislavtrifonov/work/projects/zephyr-data-logger/zephyr/soc/snps/nsim/arc_v/Kconfig"
osource "/Users/denislavtrifonov/work/projects/zephyr-data-logger/zephyr/soc/snps/nsim/arc_classic/Kconfig"
osource "/Users/denislavtrifonov/work/projects/zephyr-data-logger/zephyr/soc/snps/hsdk4xd/Kconfig"
osource "/Users/denislavtrifonov/work/projects/zephyr-data-logger/zephyr/soc/snps/hsdk/Kconfig"
osource "/Users/denislavtrifonov/work/projects/zephyr-data-logger/zephyr/soc/snps/emsk/Kconfig"
osource "/Users/denislavtrifonov/work/projects/zephyr-data-logger/zephyr/soc/snps/emsdp/Kconfig"
osource "/Users/denislavtrifonov/work/projects/zephyr-data-logger/zephyr/soc/snps/arc_iot/Kconfig"
osource "/Users/denislavtrifonov/work/projects/zephyr-data-logger/zephyr/soc/silabs/Kconfig"
osource "/Users/denislavtrifonov/work/projects/zephyr-data-logger/zephyr/soc/sifli/sf32/Kconfig"
osource "/Users/denislavtrifonov/work/projects/zephyr-data-logger/zephyr/soc/sifive/sifive_freedom/Kconfig"
osource "/Users/denislavtrifonov/work/projects/zephyr-data-logger/zephyr/soc/sensry/Kconfig"
osource "/Users/denislavtrifonov/work/projects/zephyr-data-logger/zephyr/soc/rockchip/Kconfig"
osource "/Users/denislavtrifonov/work/projects/zephyr-data-logger/zephyr/soc/renode/riscv_virtual/Kconfig"
osource "/Users/denislavtrifonov/work/projects/zephyr-data-logger/zephyr/soc/renode/cortex_r8_virtual/Kconfig"
osource "/Users/denislavtrifonov/work/projects/zephyr-data-logger/zephyr/soc/renesas/smartbond/Kconfig"
osource "/Users/denislavtrifonov/work/projects/zephyr-data-logger/zephyr/soc/renesas/rz/Kconfig"
osource "/Users/denislavtrifonov/work/projects/zephyr-data-logger/zephyr/soc/renesas/rx/Kconfig"
osource "/Users/denislavtrifonov/work/projects/zephyr-data-logger/zephyr/soc/renesas/rcar/Kconfig"
osource "/Users/denislavtrifonov/work/projects/zephyr-data-logger/zephyr/soc/renesas/ra/Kconfig"
osource "/Users/denislavtrifonov/work/projects/zephyr-data-logger/zephyr/soc/realtek/fingerprint/Kconfig"
osource "/Users/denislavtrifonov/work/projects/zephyr-data-logger/zephyr/soc/realtek/ec/Kconfig"
osource "/Users/denislavtrifonov/work/projects/zephyr-data-logger/zephyr/soc/realtek/bee/Kconfig"
osource "/Users/denislavtrifonov/work/projects/zephyr-data-logger/zephyr/soc/realtek/ameba/Kconfig"
osource "/Users/denislavtrifonov/work/projects/zephyr-data-logger/zephyr/soc/raspberrypi/rpi_pico/Kconfig"
osource "/Users/denislavtrifonov/work/projects/zephyr-data-logger/zephyr/soc/quicklogic/eos_s3/Kconfig"
osource "/Users/denislavtrifonov/work/projects/zephyr-data-logger/zephyr/soc/qemu/virt_riscv/Kconfig"
osource "/Users/denislavtrifonov/work/projects/zephyr-data-logger/zephyr/soc/qemu/or1k/Kconfig"
osource "/Users/denislavtrifonov/work/projects/zephyr-data-logger/zephyr/soc/qemu/malta/Kconfig"
osource "/Users/denislavtrifonov/work/projects/zephyr-data-logger/zephyr/soc/openisa/rv32m1/Kconfig"
osource "/Users/denislavtrifonov/work/projects/zephyr-data-logger/zephyr/soc/openhwgroup/cva6/Kconfig"
osource "/Users/denislavtrifonov/work/projects/zephyr-data-logger/zephyr/soc/oct/osd32mp15x/Kconfig"
osource "/Users/denislavtrifonov/work/projects/zephyr-data-logger/zephyr/soc/nxp/s32/Kconfig"
osource "/Users/denislavtrifonov/work/projects/zephyr-data-logger/zephyr/soc/nxp/rw/Kconfig"
osource "/Users/denislavtrifonov/work/projects/zephyr-data-logger/zephyr/soc/nxp/mcx/Kconfig"
osource "/Users/denislavtrifonov/work/projects/zephyr-data-logger/zephyr/soc/nxp/lpc/Kconfig"
osource "/Users/denislavtrifonov/work/projects/zephyr-data-logger/zephyr/soc/nxp/layerscape/Kconfig"
osource "/Users/denislavtrifonov/work/projects/zephyr-data-logger/zephyr/soc/nxp/kinetis/Kconfig"
osource "/Users/denislavtrifonov/work/projects/zephyr-data-logger/zephyr/soc/nxp/imxrt/Kconfig"
osource "/Users/denislavtrifonov/work/projects/zephyr-data-logger/zephyr/soc/nxp/imx/Kconfig"
osource "/Users/denislavtrifonov/work/projects/zephyr-data-logger/zephyr/soc/nuvoton/numicro/Kconfig"
osource "/Users/denislavtrifonov/work/projects/zephyr-data-logger/zephyr/soc/nuvoton/numaker/Kconfig"
osource "/Users/denislavtrifonov/work/projects/zephyr-data-logger/zephyr/soc/nuvoton/npcx/Kconfig"
osource "/Users/denislavtrifonov/work/projects/zephyr-data-logger/zephyr/soc/nuvoton/npcm/Kconfig"
osource "/Users/denislavtrifonov/work/projects/zephyr-data-logger/zephyr/soc/nordic/Kconfig"
osource "/Users/denislavtrifonov/work/projects/zephyr-data-logger/zephyr/soc/neorv32/Kconfig"
osource "/Users/denislavtrifonov/work/projects/zephyr-data-logger/zephyr/soc/native/inf_clock/Kconfig"
osource "/Users/denislavtrifonov/work/projects/zephyr-data-logger/zephyr/soc/microchip/sam/sama7/Kconfig"
osource "/Users/denislavtrifonov/work/projects/zephyr-data-logger/zephyr/soc/microchip/sam/sam_d5x_e5x/Kconfig"
osource "/Users/denislavtrifonov/work/projects/zephyr-data-logger/zephyr/soc/microchip/pic64/Kconfig"
osource "/Users/denislavtrifonov/work/projects/zephyr-data-logger/zephyr/soc/microchip/pic32c/pic32cz_ca/Kconfig"
osource "/Users/denislavtrifonov/work/projects/zephyr-data-logger/zephyr/soc/microchip/pic32c/pic32cx_sg/Kconfig"
osource "/Users/denislavtrifonov/work/projects/zephyr-data-logger/zephyr/soc/microchip/pic32c/pic32cm_pl/Kconfig"
osource "/Users/denislavtrifonov/work/projects/zephyr-data-logger/zephyr/soc/microchip/pic32c/pic32cm_jh/Kconfig"
osource "/Users/denislavtrifonov/work/projects/zephyr-data-logger/zephyr/soc/microchip/miv/Kconfig"
osource "/Users/denislavtrifonov/work/projects/zephyr-data-logger/zephyr/soc/microchip/mec/Kconfig"
osource "/Users/denislavtrifonov/work/projects/zephyr-data-logger/zephyr/soc/mediatek/mt8xxx/Kconfig"
osource "/Users/denislavtrifonov/work/projects/zephyr-data-logger/zephyr/soc/lowrisc/opentitan/Kconfig"
osource "/Users/denislavtrifonov/work/projects/zephyr-data-logger/zephyr/soc/litex/litex_vexriscv/Kconfig"
osource "/Users/denislavtrifonov/work/projects/zephyr-data-logger/zephyr/soc/ite/ec/Kconfig"
osource "/Users/denislavtrifonov/work/projects/zephyr-data-logger/zephyr/soc/intel/wildcat_lake/Kconfig"
osource "/Users/denislavtrifonov/work/projects/zephyr-data-logger/zephyr/soc/intel/raptor_lake/Kconfig"
osource "/Users/denislavtrifonov/work/projects/zephyr-data-logger/zephyr/soc/intel/panther_lake/Kconfig"
osource "/Users/denislavtrifonov/work/projects/zephyr-data-logger/zephyr/soc/intel/lakemont/Kconfig"
osource "/Users/denislavtrifonov/work/projects/zephyr-data-logger/zephyr/soc/intel/intel_socfpga_std/Kconfig"
osource "/Users/denislavtrifonov/work/projects/zephyr-data-logger/zephyr/soc/intel/intel_socfpga/Kconfig"
osource "/Users/denislavtrifonov/work/projects/zephyr-data-logger/zephyr/soc/intel/intel_niosv/Kconfig"
osource "/Users/denislavtrifonov/work/projects/zephyr-data-logger/zephyr/soc/intel/intel_ish/Kconfig"
osource "/Users/denislavtrifonov/work/projects/zephyr-data-logger/zephyr/soc/intel/intel_adsp/Kconfig"
osource "/Users/denislavtrifonov/work/projects/zephyr-data-logger/zephyr/soc/intel/elkhart_lake/Kconfig"
osource "/Users/denislavtrifonov/work/projects/zephyr-data-logger/zephyr/soc/intel/atom/Kconfig"
osource "/Users/denislavtrifonov/work/projects/zephyr-data-logger/zephyr/soc/intel/apollo_lake/Kconfig"
osource "/Users/denislavtrifonov/work/projects/zephyr-data-logger/zephyr/soc/intel/alder_lake/Kconfig"
osource "/Users/denislavtrifonov/work/projects/zephyr-data-logger/zephyr/soc/infineon/psoc4/Kconfig"
osource "/Users/denislavtrifonov/work/projects/zephyr-data-logger/zephyr/soc/infineon/edge/Kconfig"
osource "/Users/denislavtrifonov/work/projects/zephyr-data-logger/zephyr/soc/infineon/cat3/Kconfig"
osource "/Users/denislavtrifonov/work/projects/zephyr-data-logger/zephyr/soc/infineon/cat1c/Kconfig"
osource "/Users/denislavtrifonov/work/projects/zephyr-data-logger/zephyr/soc/infineon/cat1b/Kconfig"
osource "/Users/denislavtrifonov/work/projects/zephyr-data-logger/zephyr/soc/infineon/cat1a/Kconfig"
osource "/Users/denislavtrifonov/work/projects/zephyr-data-logger/zephyr/soc/gd/gd32/Kconfig"
osource "/Users/denislavtrifonov/work/projects/zephyr-data-logger/zephyr/soc/gaisler/leon3/Kconfig"
osource "/Users/denislavtrifonov/work/projects/zephyr-data-logger/zephyr/soc/gaisler/gr716a/Kconfig"
osource "/Users/denislavtrifonov/work/projects/zephyr-data-logger/zephyr/soc/focaltech/Kconfig"
osource "/Users/denislavtrifonov/work/projects/zephyr-data-logger/zephyr/soc/espressif/Kconfig"
osource "/Users/denislavtrifonov/work/projects/zephyr-data-logger/zephyr/soc/ene/kb1200/Kconfig"
osource "/Users/denislavtrifonov/work/projects/zephyr-data-logger/zephyr/soc/ene/kb106x/Kconfig"
osource "/Users/denislavtrifonov/work/projects/zephyr-data-logger/zephyr/soc/elan/em32f967/Kconfig"
osource "/Users/denislavtrifonov/work/projects/zephyr-data-logger/zephyr/soc/egis/Kconfig"
osource "/Users/denislavtrifonov/work/projects/zephyr-data-logger/zephyr/soc/efinix/sapphire/Kconfig"
osource "/Users/denislavtrifonov/work/projects/zephyr-data-logger/zephyr/soc/cdns/xtensa_sample_controller/Kconfig"
osource "/Users/denislavtrifonov/work/projects/zephyr-data-logger/zephyr/soc/cdns/swerv/Kconfig"
osource "/Users/denislavtrifonov/work/projects/zephyr-data-logger/zephyr/soc/cdns/sample_controller32/Kconfig"
osource "/Users/denislavtrifonov/work/projects/zephyr-data-logger/zephyr/soc/cdns/dc233c/Kconfig"
osource "/Users/denislavtrifonov/work/projects/zephyr-data-logger/zephyr/soc/brcm/bcmvk/Kconfig"
osource "/Users/denislavtrifonov/work/projects/zephyr-data-logger/zephyr/soc/brcm/bcm2712/Kconfig"
osource "/Users/denislavtrifonov/work/projects/zephyr-data-logger/zephyr/soc/brcm/bcm2711/Kconfig"
osource "/Users/denislavtrifonov/work/projects/zephyr-data-logger/zephyr/soc/blackberry/qnxhv_vm/Kconfig"
osource "/Users/denislavtrifonov/work/projects/zephyr-data-logger/zephyr/soc/bflb/Kconfig"
osource "/Users/denislavtrifonov/work/projects/zephyr-data-logger/zephyr/soc/atmel/sam0/Kconfig"
osource "/Users/denislavtrifonov/work/projects/zephyr-data-logger/zephyr/soc/atmel/sam/Kconfig"
osource "/Users/denislavtrifonov/work/projects/zephyr-data-logger/zephyr/soc/aspeed/Kconfig"
osource "/Users/denislavtrifonov/work/projects/zephyr-data-logger/zephyr/soc/arm/Kconfig"
osource "/Users/denislavtrifonov/work/projects/zephyr-data-logger/zephyr/soc/arm/beetle/Kconfig"
osource "/Users/denislavtrifonov/work/projects/zephyr-data-logger/zephyr/soc/antmicro/myra/Kconfig"
osource "/Users/denislavtrifonov/work/projects/zephyr-data-logger/zephyr/soc/andestech/Kconfig"
osource "/Users/denislavtrifonov/work/projects/zephyr-data-logger/zephyr/soc/amd/acp_6_0/Kconfig"
osource "/Users/denislavtrifonov/work/projects/zephyr-data-logger/zephyr/soc/ambiq/Kconfig"
osource "/Users/denislavtrifonov/work/projects/zephyr-data-logger/zephyr/soc/allwinner/sun8i_h3/Kconfig"
osource "/Users/denislavtrifonov/work/projects/zephyr-data-logger/zephyr/soc/alif/ensemble/Kconfig"
osource "/Users/denislavtrifonov/work/projects/zephyr-data-logger/zephyr/soc/aesc/Kconfig"
osource "/Users/denislavtrifonov/work/projects/zephyr-data-logger/zephyr/soc/adi/max32/Kconfig"
```
