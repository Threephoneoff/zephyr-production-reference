## build/Kconfig/soc/Kconfig.soc
```kconfig
# Load SoC Kconfig descriptions.
osource "/Users/denislavtrifonov/work/projects/zephyr-data-logger/zephyr/soc/xlnx/zynqmp/Kconfig.soc"
osource "/Users/denislavtrifonov/work/projects/zephyr-data-logger/zephyr/soc/xlnx/zynq7000/Kconfig.soc"
osource "/Users/denislavtrifonov/work/projects/zephyr-data-logger/zephyr/soc/xlnx/versalnet/Kconfig.soc"
osource "/Users/denislavtrifonov/work/projects/zephyr-data-logger/zephyr/soc/xlnx/versal2/Kconfig.soc"
osource "/Users/denislavtrifonov/work/projects/zephyr-data-logger/zephyr/soc/xlnx/versal/Kconfig.soc"
osource "/Users/denislavtrifonov/work/projects/zephyr-data-logger/zephyr/soc/xen/Kconfig.soc"
osource "/Users/denislavtrifonov/work/projects/zephyr-data-logger/zephyr/soc/wch/ch32v/Kconfig.soc"
osource "/Users/denislavtrifonov/work/projects/zephyr-data-logger/zephyr/soc/ti/simplelink/Kconfig.soc"
osource "/Users/denislavtrifonov/work/projects/zephyr-data-logger/zephyr/soc/ti/mspm0/Kconfig.soc"
osource "/Users/denislavtrifonov/work/projects/zephyr-data-logger/zephyr/soc/ti/lm3s6965/Kconfig.soc"
osource "/Users/denislavtrifonov/work/projects/zephyr-data-logger/zephyr/soc/ti/k3/Kconfig.soc"
osource "/Users/denislavtrifonov/work/projects/zephyr-data-logger/zephyr/soc/telink/tlsr/Kconfig.soc"
osource "/Users/denislavtrifonov/work/projects/zephyr-data-logger/zephyr/soc/syna/sr100/Kconfig.soc"
osource "/Users/denislavtrifonov/work/projects/zephyr-data-logger/zephyr/soc/starfive/jh71xx/Kconfig.soc"
osource "/Users/denislavtrifonov/work/projects/zephyr-data-logger/zephyr/soc/st/stm32/Kconfig.soc"
osource "/Users/denislavtrifonov/work/projects/zephyr-data-logger/zephyr/soc/snps/qemu_arc/Kconfig.soc"
osource "/Users/denislavtrifonov/work/projects/zephyr-data-logger/zephyr/soc/snps/nsim/arc_v/Kconfig.soc"
osource "/Users/denislavtrifonov/work/projects/zephyr-data-logger/zephyr/soc/snps/nsim/arc_classic/Kconfig.soc"
osource "/Users/denislavtrifonov/work/projects/zephyr-data-logger/zephyr/soc/snps/hsdk4xd/Kconfig.soc"
osource "/Users/denislavtrifonov/work/projects/zephyr-data-logger/zephyr/soc/snps/hsdk/Kconfig.soc"
osource "/Users/denislavtrifonov/work/projects/zephyr-data-logger/zephyr/soc/snps/emsk/Kconfig.soc"
osource "/Users/denislavtrifonov/work/projects/zephyr-data-logger/zephyr/soc/snps/emsdp/Kconfig.soc"
osource "/Users/denislavtrifonov/work/projects/zephyr-data-logger/zephyr/soc/snps/arc_iot/Kconfig.soc"
osource "/Users/denislavtrifonov/work/projects/zephyr-data-logger/zephyr/soc/silabs/Kconfig.soc"
osource "/Users/denislavtrifonov/work/projects/zephyr-data-logger/zephyr/soc/sifli/sf32/Kconfig.soc"
osource "/Users/denislavtrifonov/work/projects/zephyr-data-logger/zephyr/soc/sifive/sifive_freedom/Kconfig.soc"
osource "/Users/denislavtrifonov/work/projects/zephyr-data-logger/zephyr/soc/sensry/Kconfig.soc"
osource "/Users/denislavtrifonov/work/projects/zephyr-data-logger/zephyr/soc/rockchip/Kconfig.soc"
osource "/Users/denislavtrifonov/work/projects/zephyr-data-logger/zephyr/soc/renode/riscv_virtual/Kconfig.soc"
osource "/Users/denislavtrifonov/work/projects/zephyr-data-logger/zephyr/soc/renode/cortex_r8_virtual/Kconfig.soc"
osource "/Users/denislavtrifonov/work/projects/zephyr-data-logger/zephyr/soc/renesas/smartbond/Kconfig.soc"
osource "/Users/denislavtrifonov/work/projects/zephyr-data-logger/zephyr/soc/renesas/rz/Kconfig.soc"
osource "/Users/denislavtrifonov/work/projects/zephyr-data-logger/zephyr/soc/renesas/rx/Kconfig.soc"
osource "/Users/denislavtrifonov/work/projects/zephyr-data-logger/zephyr/soc/renesas/rcar/Kconfig.soc"
osource "/Users/denislavtrifonov/work/projects/zephyr-data-logger/zephyr/soc/renesas/ra/Kconfig.soc"
osource "/Users/denislavtrifonov/work/projects/zephyr-data-logger/zephyr/soc/realtek/fingerprint/Kconfig.soc"
osource "/Users/denislavtrifonov/work/projects/zephyr-data-logger/zephyr/soc/realtek/ec/Kconfig.soc"
osource "/Users/denislavtrifonov/work/projects/zephyr-data-logger/zephyr/soc/realtek/bee/Kconfig.soc"
osource "/Users/denislavtrifonov/work/projects/zephyr-data-logger/zephyr/soc/realtek/ameba/Kconfig.soc"
osource "/Users/denislavtrifonov/work/projects/zephyr-data-logger/zephyr/soc/raspberrypi/rpi_pico/Kconfig.soc"
osource "/Users/denislavtrifonov/work/projects/zephyr-data-logger/zephyr/soc/quicklogic/eos_s3/Kconfig.soc"
osource "/Users/denislavtrifonov/work/projects/zephyr-data-logger/zephyr/soc/qemu/virt_riscv/Kconfig.soc"
osource "/Users/denislavtrifonov/work/projects/zephyr-data-logger/zephyr/soc/qemu/or1k/Kconfig.soc"
osource "/Users/denislavtrifonov/work/projects/zephyr-data-logger/zephyr/soc/qemu/malta/Kconfig.soc"
osource "/Users/denislavtrifonov/work/projects/zephyr-data-logger/zephyr/soc/openisa/rv32m1/Kconfig.soc"
osource "/Users/denislavtrifonov/work/projects/zephyr-data-logger/zephyr/soc/openhwgroup/cva6/Kconfig.soc"
osource "/Users/denislavtrifonov/work/projects/zephyr-data-logger/zephyr/soc/oct/osd32mp15x/Kconfig.soc"
osource "/Users/denislavtrifonov/work/projects/zephyr-data-logger/zephyr/soc/nxp/s32/Kconfig.soc"
osource "/Users/denislavtrifonov/work/projects/zephyr-data-logger/zephyr/soc/nxp/rw/Kconfig.soc"
osource "/Users/denislavtrifonov/work/projects/zephyr-data-logger/zephyr/soc/nxp/mcx/Kconfig.soc"
osource "/Users/denislavtrifonov/work/projects/zephyr-data-logger/zephyr/soc/nxp/lpc/Kconfig.soc"
osource "/Users/denislavtrifonov/work/projects/zephyr-data-logger/zephyr/soc/nxp/layerscape/Kconfig.soc"
osource "/Users/denislavtrifonov/work/projects/zephyr-data-logger/zephyr/soc/nxp/kinetis/Kconfig.soc"
osource "/Users/denislavtrifonov/work/projects/zephyr-data-logger/zephyr/soc/nxp/imxrt/Kconfig.soc"
osource "/Users/denislavtrifonov/work/projects/zephyr-data-logger/zephyr/soc/nxp/imx/Kconfig.soc"
osource "/Users/denislavtrifonov/work/projects/zephyr-data-logger/zephyr/soc/nuvoton/numicro/Kconfig.soc"
osource "/Users/denislavtrifonov/work/projects/zephyr-data-logger/zephyr/soc/nuvoton/numaker/Kconfig.soc"
osource "/Users/denislavtrifonov/work/projects/zephyr-data-logger/zephyr/soc/nuvoton/npcx/Kconfig.soc"
osource "/Users/denislavtrifonov/work/projects/zephyr-data-logger/zephyr/soc/nuvoton/npcm/Kconfig.soc"
osource "/Users/denislavtrifonov/work/projects/zephyr-data-logger/zephyr/soc/nordic/Kconfig.soc"
osource "/Users/denislavtrifonov/work/projects/zephyr-data-logger/zephyr/soc/neorv32/Kconfig.soc"
osource "/Users/denislavtrifonov/work/projects/zephyr-data-logger/zephyr/soc/native/inf_clock/Kconfig.soc"
osource "/Users/denislavtrifonov/work/projects/zephyr-data-logger/zephyr/soc/microchip/sam/sama7/Kconfig.soc"
osource "/Users/denislavtrifonov/work/projects/zephyr-data-logger/zephyr/soc/microchip/sam/sam_d5x_e5x/Kconfig.soc"
osource "/Users/denislavtrifonov/work/projects/zephyr-data-logger/zephyr/soc/microchip/pic64/Kconfig.soc"
osource "/Users/denislavtrifonov/work/projects/zephyr-data-logger/zephyr/soc/microchip/pic32c/pic32cz_ca/Kconfig.soc"
osource "/Users/denislavtrifonov/work/projects/zephyr-data-logger/zephyr/soc/microchip/pic32c/pic32cx_sg/Kconfig.soc"
osource "/Users/denislavtrifonov/work/projects/zephyr-data-logger/zephyr/soc/microchip/pic32c/pic32cm_pl/Kconfig.soc"
osource "/Users/denislavtrifonov/work/projects/zephyr-data-logger/zephyr/soc/microchip/pic32c/pic32cm_jh/Kconfig.soc"
osource "/Users/denislavtrifonov/work/projects/zephyr-data-logger/zephyr/soc/microchip/miv/Kconfig.soc"
osource "/Users/denislavtrifonov/work/projects/zephyr-data-logger/zephyr/soc/microchip/mec/Kconfig.soc"
osource "/Users/denislavtrifonov/work/projects/zephyr-data-logger/zephyr/soc/mediatek/mt8xxx/Kconfig.soc"
osource "/Users/denislavtrifonov/work/projects/zephyr-data-logger/zephyr/soc/lowrisc/opentitan/Kconfig.soc"
osource "/Users/denislavtrifonov/work/projects/zephyr-data-logger/zephyr/soc/litex/litex_vexriscv/Kconfig.soc"
osource "/Users/denislavtrifonov/work/projects/zephyr-data-logger/zephyr/soc/ite/ec/Kconfig.soc"
osource "/Users/denislavtrifonov/work/projects/zephyr-data-logger/zephyr/soc/intel/wildcat_lake/Kconfig.soc"
osource "/Users/denislavtrifonov/work/projects/zephyr-data-logger/zephyr/soc/intel/raptor_lake/Kconfig.soc"
osource "/Users/denislavtrifonov/work/projects/zephyr-data-logger/zephyr/soc/intel/panther_lake/Kconfig.soc"
osource "/Users/denislavtrifonov/work/projects/zephyr-data-logger/zephyr/soc/intel/lakemont/Kconfig.soc"
osource "/Users/denislavtrifonov/work/projects/zephyr-data-logger/zephyr/soc/intel/intel_socfpga_std/Kconfig.soc"
osource "/Users/denislavtrifonov/work/projects/zephyr-data-logger/zephyr/soc/intel/intel_socfpga/Kconfig.soc"
osource "/Users/denislavtrifonov/work/projects/zephyr-data-logger/zephyr/soc/intel/intel_niosv/Kconfig.soc"
osource "/Users/denislavtrifonov/work/projects/zephyr-data-logger/zephyr/soc/intel/intel_ish/Kconfig.soc"
osource "/Users/denislavtrifonov/work/projects/zephyr-data-logger/zephyr/soc/intel/intel_adsp/Kconfig.soc"
osource "/Users/denislavtrifonov/work/projects/zephyr-data-logger/zephyr/soc/intel/elkhart_lake/Kconfig.soc"
osource "/Users/denislavtrifonov/work/projects/zephyr-data-logger/zephyr/soc/intel/atom/Kconfig.soc"
osource "/Users/denislavtrifonov/work/projects/zephyr-data-logger/zephyr/soc/intel/apollo_lake/Kconfig.soc"
osource "/Users/denislavtrifonov/work/projects/zephyr-data-logger/zephyr/soc/intel/alder_lake/Kconfig.soc"
osource "/Users/denislavtrifonov/work/projects/zephyr-data-logger/zephyr/soc/infineon/psoc4/Kconfig.soc"
osource "/Users/denislavtrifonov/work/projects/zephyr-data-logger/zephyr/soc/infineon/edge/Kconfig.soc"
osource "/Users/denislavtrifonov/work/projects/zephyr-data-logger/zephyr/soc/infineon/cat3/Kconfig.soc"
osource "/Users/denislavtrifonov/work/projects/zephyr-data-logger/zephyr/soc/infineon/cat1c/Kconfig.soc"
osource "/Users/denislavtrifonov/work/projects/zephyr-data-logger/zephyr/soc/infineon/cat1b/Kconfig.soc"
osource "/Users/denislavtrifonov/work/projects/zephyr-data-logger/zephyr/soc/infineon/cat1a/Kconfig.soc"
osource "/Users/denislavtrifonov/work/projects/zephyr-data-logger/zephyr/soc/gd/gd32/Kconfig.soc"
osource "/Users/denislavtrifonov/work/projects/zephyr-data-logger/zephyr/soc/gaisler/leon3/Kconfig.soc"
osource "/Users/denislavtrifonov/work/projects/zephyr-data-logger/zephyr/soc/gaisler/gr716a/Kconfig.soc"
osource "/Users/denislavtrifonov/work/projects/zephyr-data-logger/zephyr/soc/focaltech/Kconfig.soc"
osource "/Users/denislavtrifonov/work/projects/zephyr-data-logger/zephyr/soc/espressif/Kconfig.soc"
osource "/Users/denislavtrifonov/work/projects/zephyr-data-logger/zephyr/soc/ene/kb1200/Kconfig.soc"
osource "/Users/denislavtrifonov/work/projects/zephyr-data-logger/zephyr/soc/ene/kb106x/Kconfig.soc"
osource "/Users/denislavtrifonov/work/projects/zephyr-data-logger/zephyr/soc/elan/em32f967/Kconfig.soc"
osource "/Users/denislavtrifonov/work/projects/zephyr-data-logger/zephyr/soc/egis/Kconfig.soc"
osource "/Users/denislavtrifonov/work/projects/zephyr-data-logger/zephyr/soc/efinix/sapphire/Kconfig.soc"
osource "/Users/denislavtrifonov/work/projects/zephyr-data-logger/zephyr/soc/cdns/xtensa_sample_controller/Kconfig.soc"
osource "/Users/denislavtrifonov/work/projects/zephyr-data-logger/zephyr/soc/cdns/swerv/Kconfig.soc"
osource "/Users/denislavtrifonov/work/projects/zephyr-data-logger/zephyr/soc/cdns/sample_controller32/Kconfig.soc"
osource "/Users/denislavtrifonov/work/projects/zephyr-data-logger/zephyr/soc/cdns/dc233c/Kconfig.soc"
osource "/Users/denislavtrifonov/work/projects/zephyr-data-logger/zephyr/soc/brcm/bcmvk/Kconfig.soc"
osource "/Users/denislavtrifonov/work/projects/zephyr-data-logger/zephyr/soc/brcm/bcm2712/Kconfig.soc"
osource "/Users/denislavtrifonov/work/projects/zephyr-data-logger/zephyr/soc/brcm/bcm2711/Kconfig.soc"
osource "/Users/denislavtrifonov/work/projects/zephyr-data-logger/zephyr/soc/blackberry/qnxhv_vm/Kconfig.soc"
osource "/Users/denislavtrifonov/work/projects/zephyr-data-logger/zephyr/soc/bflb/Kconfig.soc"
osource "/Users/denislavtrifonov/work/projects/zephyr-data-logger/zephyr/soc/atmel/sam0/Kconfig.soc"
osource "/Users/denislavtrifonov/work/projects/zephyr-data-logger/zephyr/soc/atmel/sam/Kconfig.soc"
osource "/Users/denislavtrifonov/work/projects/zephyr-data-logger/zephyr/soc/aspeed/Kconfig.soc"
osource "/Users/denislavtrifonov/work/projects/zephyr-data-logger/zephyr/soc/arm/Kconfig.soc"
osource "/Users/denislavtrifonov/work/projects/zephyr-data-logger/zephyr/soc/arm/beetle/Kconfig.soc"
osource "/Users/denislavtrifonov/work/projects/zephyr-data-logger/zephyr/soc/antmicro/myra/Kconfig.soc"
osource "/Users/denislavtrifonov/work/projects/zephyr-data-logger/zephyr/soc/andestech/Kconfig.soc"
osource "/Users/denislavtrifonov/work/projects/zephyr-data-logger/zephyr/soc/amd/acp_6_0/Kconfig.soc"
osource "/Users/denislavtrifonov/work/projects/zephyr-data-logger/zephyr/soc/ambiq/Kconfig.soc"
osource "/Users/denislavtrifonov/work/projects/zephyr-data-logger/zephyr/soc/allwinner/sun8i_h3/Kconfig.soc"
osource "/Users/denislavtrifonov/work/projects/zephyr-data-logger/zephyr/soc/alif/ensemble/Kconfig.soc"
osource "/Users/denislavtrifonov/work/projects/zephyr-data-logger/zephyr/soc/aesc/Kconfig.soc"
osource "/Users/denislavtrifonov/work/projects/zephyr-data-logger/zephyr/soc/adi/max32/Kconfig.soc"
```
