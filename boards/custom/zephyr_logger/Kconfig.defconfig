## build/Kconfig/soc/Kconfig.sysbuild
```kconfig
# Load Sysbuild SoC Kconfig descriptions.
osource "/Users/denislavtrifonov/work/projects/zephyr-data-logger/zephyr/soc/xlnx/zynqmp/Kconfig.sysbuild"
osource "/Users/denislavtrifonov/work/projects/zephyr-data-logger/zephyr/soc/xlnx/zynq7000/Kconfig.sysbuild"
osource "/Users/denislavtrifonov/work/projects/zephyr-data-logger/zephyr/soc/xlnx/versalnet/Kconfig.sysbuild"
osource "/Users/denislavtrifonov/work/projects/zephyr-data-logger/zephyr/soc/xlnx/versal2/Kconfig.sysbuild"
osource "/Users/denislavtrifonov/work/projects/zephyr-data-logger/zephyr/soc/xlnx/versal/Kconfig.sysbuild"
osource "/Users/denislavtrifonov/work/projects/zephyr-data-logger/zephyr/soc/xen/Kconfig.sysbuild"
osource "/Users/denislavtrifonov/work/projects/zephyr-data-logger/zephyr/soc/wch/ch32v/Kconfig.sysbuild"
osource "/Users/denislavtrifonov/work/projects/zephyr-data-logger/zephyr/soc/ti/simplelink/Kconfig.sysbuild"
osource "/Users/denislavtrifonov/work/projects/zephyr-data-logger/zephyr/soc/ti/mspm0/Kconfig.sysbuild"
osource "/Users/denislavtrifonov/work/projects/zephyr-data-logger/zephyr/soc/ti/lm3s6965/Kconfig.sysbuild"
osource "/Users/denislavtrifonov/work/projects/zephyr-data-logger/zephyr/soc/ti/k3/Kconfig.sysbuild"
osource "/Users/denislavtrifonov/work/projects/zephyr-data-logger/zephyr/soc/telink/tlsr/Kconfig.sysbuild"
osource "/Users/denislavtrifonov/work/projects/zephyr-data-logger/zephyr/soc/syna/sr100/Kconfig.sysbuild"
osource "/Users/denislavtrifonov/work/projects/zephyr-data-logger/zephyr/soc/starfive/jh71xx/Kconfig.sysbuild"
osource "/Users/denislavtrifonov/work/projects/zephyr-data-logger/zephyr/soc/st/stm32/Kconfig.sysbuild"
osource "/Users/denislavtrifonov/work/projects/zephyr-data-logger/zephyr/soc/snps/qemu_arc/Kconfig.sysbuild"
osource "/Users/denislavtrifonov/work/projects/zephyr-data-logger/zephyr/soc/snps/nsim/arc_v/Kconfig.sysbuild"
osource "/Users/denislavtrifonov/work/projects/zephyr-data-logger/zephyr/soc/snps/nsim/arc_classic/Kconfig.sysbuild"
osource "/Users/denislavtrifonov/work/projects/zephyr-data-logger/zephyr/soc/snps/hsdk4xd/Kconfig.sysbuild"
osource "/Users/denislavtrifonov/work/projects/zephyr-data-logger/zephyr/soc/snps/hsdk/Kconfig.sysbuild"
osource "/Users/denislavtrifonov/work/projects/zephyr-data-logger/zephyr/soc/snps/emsk/Kconfig.sysbuild"
osource "/Users/denislavtrifonov/work/projects/zephyr-data-logger/zephyr/soc/snps/emsdp/Kconfig.sysbuild"
osource "/Users/denislavtrifonov/work/projects/zephyr-data-logger/zephyr/soc/snps/arc_iot/Kconfig.sysbuild"
osource "/Users/denislavtrifonov/work/projects/zephyr-data-logger/zephyr/soc/silabs/Kconfig.sysbuild"
osource "/Users/denislavtrifonov/work/projects/zephyr-data-logger/zephyr/soc/sifli/sf32/Kconfig.sysbuild"
osource "/Users/denislavtrifonov/work/projects/zephyr-data-logger/zephyr/soc/sifive/sifive_freedom/Kconfig.sysbuild"
osource "/Users/denislavtrifonov/work/projects/zephyr-data-logger/zephyr/soc/sensry/Kconfig.sysbuild"
osource "/Users/denislavtrifonov/work/projects/zephyr-data-logger/zephyr/soc/rockchip/Kconfig.sysbuild"
osource "/Users/denislavtrifonov/work/projects/zephyr-data-logger/zephyr/soc/renode/riscv_virtual/Kconfig.sysbuild"
osource "/Users/denislavtrifonov/work/projects/zephyr-data-logger/zephyr/soc/renode/cortex_r8_virtual/Kconfig.sysbuild"
osource "/Users/denislavtrifonov/work/projects/zephyr-data-logger/zephyr/soc/renesas/smartbond/Kconfig.sysbuild"
osource "/Users/denislavtrifonov/work/projects/zephyr-data-logger/zephyr/soc/renesas/rz/Kconfig.sysbuild"
osource "/Users/denislavtrifonov/work/projects/zephyr-data-logger/zephyr/soc/renesas/rx/Kconfig.sysbuild"
osource "/Users/denislavtrifonov/work/projects/zephyr-data-logger/zephyr/soc/renesas/rcar/Kconfig.sysbuild"
osource "/Users/denislavtrifonov/work/projects/zephyr-data-logger/zephyr/soc/renesas/ra/Kconfig.sysbuild"
osource "/Users/denislavtrifonov/work/projects/zephyr-data-logger/zephyr/soc/realtek/fingerprint/Kconfig.sysbuild"
osource "/Users/denislavtrifonov/work/projects/zephyr-data-logger/zephyr/soc/realtek/ec/Kconfig.sysbuild"
osource "/Users/denislavtrifonov/work/projects/zephyr-data-logger/zephyr/soc/realtek/bee/Kconfig.sysbuild"
osource "/Users/denislavtrifonov/work/projects/zephyr-data-logger/zephyr/soc/realtek/ameba/Kconfig.sysbuild"
osource "/Users/denislavtrifonov/work/projects/zephyr-data-logger/zephyr/soc/raspberrypi/rpi_pico/Kconfig.sysbuild"
osource "/Users/denislavtrifonov/work/projects/zephyr-data-logger/zephyr/soc/quicklogic/eos_s3/Kconfig.sysbuild"
osource "/Users/denislavtrifonov/work/projects/zephyr-data-logger/zephyr/soc/qemu/virt_riscv/Kconfig.sysbuild"
osource "/Users/denislavtrifonov/work/projects/zephyr-data-logger/zephyr/soc/qemu/or1k/Kconfig.sysbuild"
osource "/Users/denislavtrifonov/work/projects/zephyr-data-logger/zephyr/soc/qemu/malta/Kconfig.sysbuild"
osource "/Users/denislavtrifonov/work/projects/zephyr-data-logger/zephyr/soc/openisa/rv32m1/Kconfig.sysbuild"
osource "/Users/denislavtrifonov/work/projects/zephyr-data-logger/zephyr/soc/openhwgroup/cva6/Kconfig.sysbuild"
osource "/Users/denislavtrifonov/work/projects/zephyr-data-logger/zephyr/soc/oct/osd32mp15x/Kconfig.sysbuild"
osource "/Users/denislavtrifonov/work/projects/zephyr-data-logger/zephyr/soc/nxp/s32/Kconfig.sysbuild"
osource "/Users/denislavtrifonov/work/projects/zephyr-data-logger/zephyr/soc/nxp/rw/Kconfig.sysbuild"
osource "/Users/denislavtrifonov/work/projects/zephyr-data-logger/zephyr/soc/nxp/mcx/Kconfig.sysbuild"
osource "/Users/denislavtrifonov/work/projects/zephyr-data-logger/zephyr/soc/nxp/lpc/Kconfig.sysbuild"
osource "/Users/denislavtrifonov/work/projects/zephyr-data-logger/zephyr/soc/nxp/layerscape/Kconfig.sysbuild"
osource "/Users/denislavtrifonov/work/projects/zephyr-data-logger/zephyr/soc/nxp/kinetis/Kconfig.sysbuild"
osource "/Users/denislavtrifonov/work/projects/zephyr-data-logger/zephyr/soc/nxp/imxrt/Kconfig.sysbuild"
osource "/Users/denislavtrifonov/work/projects/zephyr-data-logger/zephyr/soc/nxp/imx/Kconfig.sysbuild"
osource "/Users/denislavtrifonov/work/projects/zephyr-data-logger/zephyr/soc/nuvoton/numicro/Kconfig.sysbuild"
osource "/Users/denislavtrifonov/work/projects/zephyr-data-logger/zephyr/soc/nuvoton/numaker/Kconfig.sysbuild"
osource "/Users/denislavtrifonov/work/projects/zephyr-data-logger/zephyr/soc/nuvoton/npcx/Kconfig.sysbuild"
osource "/Users/denislavtrifonov/work/projects/zephyr-data-logger/zephyr/soc/nuvoton/npcm/Kconfig.sysbuild"
osource "/Users/denislavtrifonov/work/projects/zephyr-data-logger/zephyr/soc/nordic/Kconfig.sysbuild"
osource "/Users/denislavtrifonov/work/projects/zephyr-data-logger/zephyr/soc/neorv32/Kconfig.sysbuild"
osource "/Users/denislavtrifonov/work/projects/zephyr-data-logger/zephyr/soc/native/inf_clock/Kconfig.sysbuild"
osource "/Users/denislavtrifonov/work/projects/zephyr-data-logger/zephyr/soc/microchip/sam/sama7/Kconfig.sysbuild"
osource "/Users/denislavtrifonov/work/projects/zephyr-data-logger/zephyr/soc/microchip/sam/sam_d5x_e5x/Kconfig.sysbuild"
osource "/Users/denislavtrifonov/work/projects/zephyr-data-logger/zephyr/soc/microchip/pic64/Kconfig.sysbuild"
osource "/Users/denislavtrifonov/work/projects/zephyr-data-logger/zephyr/soc/microchip/pic32c/pic32cz_ca/Kconfig.sysbuild"
osource "/Users/denislavtrifonov/work/projects/zephyr-data-logger/zephyr/soc/microchip/pic32c/pic32cx_sg/Kconfig.sysbuild"
osource "/Users/denislavtrifonov/work/projects/zephyr-data-logger/zephyr/soc/microchip/pic32c/pic32cm_pl/Kconfig.sysbuild"
osource "/Users/denislavtrifonov/work/projects/zephyr-data-logger/zephyr/soc/microchip/pic32c/pic32cm_jh/Kconfig.sysbuild"
osource "/Users/denislavtrifonov/work/projects/zephyr-data-logger/zephyr/soc/microchip/miv/Kconfig.sysbuild"
osource "/Users/denislavtrifonov/work/projects/zephyr-data-logger/zephyr/soc/microchip/mec/Kconfig.sysbuild"
osource "/Users/denislavtrifonov/work/projects/zephyr-data-logger/zephyr/soc/mediatek/mt8xxx/Kconfig.sysbuild"
osource "/Users/denislavtrifonov/work/projects/zephyr-data-logger/zephyr/soc/lowrisc/opentitan/Kconfig.sysbuild"
osource "/Users/denislavtrifonov/work/projects/zephyr-data-logger/zephyr/soc/litex/litex_vexriscv/Kconfig.sysbuild"
osource "/Users/denislavtrifonov/work/projects/zephyr-data-logger/zephyr/soc/ite/ec/Kconfig.sysbuild"
osource "/Users/denislavtrifonov/work/projects/zephyr-data-logger/zephyr/soc/intel/wildcat_lake/Kconfig.sysbuild"
osource "/Users/denislavtrifonov/work/projects/zephyr-data-logger/zephyr/soc/intel/raptor_lake/Kconfig.sysbuild"
osource "/Users/denislavtrifonov/work/projects/zephyr-data-logger/zephyr/soc/intel/panther_lake/Kconfig.sysbuild"
osource "/Users/denislavtrifonov/work/projects/zephyr-data-logger/zephyr/soc/intel/lakemont/Kconfig.sysbuild"
osource "/Users/denislavtrifonov/work/projects/zephyr-data-logger/zephyr/soc/intel/intel_socfpga_std/Kconfig.sysbuild"
osource "/Users/denislavtrifonov/work/projects/zephyr-data-logger/zephyr/soc/intel/intel_socfpga/Kconfig.sysbuild"
osource "/Users/denislavtrifonov/work/projects/zephyr-data-logger/zephyr/soc/intel/intel_niosv/Kconfig.sysbuild"
osource "/Users/denislavtrifonov/work/projects/zephyr-data-logger/zephyr/soc/intel/intel_ish/Kconfig.sysbuild"
osource "/Users/denislavtrifonov/work/projects/zephyr-data-logger/zephyr/soc/intel/intel_adsp/Kconfig.sysbuild"
osource "/Users/denislavtrifonov/work/projects/zephyr-data-logger/zephyr/soc/intel/elkhart_lake/Kconfig.sysbuild"
osource "/Users/denislavtrifonov/work/projects/zephyr-data-logger/zephyr/soc/intel/atom/Kconfig.sysbuild"
osource "/Users/denislavtrifonov/work/projects/zephyr-data-logger/zephyr/soc/intel/apollo_lake/Kconfig.sysbuild"
osource "/Users/denislavtrifonov/work/projects/zephyr-data-logger/zephyr/soc/intel/alder_lake/Kconfig.sysbuild"
osource "/Users/denislavtrifonov/work/projects/zephyr-data-logger/zephyr/soc/infineon/psoc4/Kconfig.sysbuild"
osource "/Users/denislavtrifonov/work/projects/zephyr-data-logger/zephyr/soc/infineon/edge/Kconfig.sysbuild"
osource "/Users/denislavtrifonov/work/projects/zephyr-data-logger/zephyr/soc/infineon/cat3/Kconfig.sysbuild"
osource "/Users/denislavtrifonov/work/projects/zephyr-data-logger/zephyr/soc/infineon/cat1c/Kconfig.sysbuild"
osource "/Users/denislavtrifonov/work/projects/zephyr-data-logger/zephyr/soc/infineon/cat1b/Kconfig.sysbuild"
osource "/Users/denislavtrifonov/work/projects/zephyr-data-logger/zephyr/soc/infineon/cat1a/Kconfig.sysbuild"
osource "/Users/denislavtrifonov/work/projects/zephyr-data-logger/zephyr/soc/gd/gd32/Kconfig.sysbuild"
osource "/Users/denislavtrifonov/work/projects/zephyr-data-logger/zephyr/soc/gaisler/leon3/Kconfig.sysbuild"
osource "/Users/denislavtrifonov/work/projects/zephyr-data-logger/zephyr/soc/gaisler/gr716a/Kconfig.sysbuild"
osource "/Users/denislavtrifonov/work/projects/zephyr-data-logger/zephyr/soc/focaltech/Kconfig.sysbuild"
osource "/Users/denislavtrifonov/work/projects/zephyr-data-logger/zephyr/soc/espressif/Kconfig.sysbuild"
osource "/Users/denislavtrifonov/work/projects/zephyr-data-logger/zephyr/soc/ene/kb1200/Kconfig.sysbuild"
osource "/Users/denislavtrifonov/work/projects/zephyr-data-logger/zephyr/soc/ene/kb106x/Kconfig.sysbuild"
osource "/Users/denislavtrifonov/work/projects/zephyr-data-logger/zephyr/soc/elan/em32f967/Kconfig.sysbuild"
osource "/Users/denislavtrifonov/work/projects/zephyr-data-logger/zephyr/soc/egis/Kconfig.sysbuild"
osource "/Users/denislavtrifonov/work/projects/zephyr-data-logger/zephyr/soc/efinix/sapphire/Kconfig.sysbuild"
osource "/Users/denislavtrifonov/work/projects/zephyr-data-logger/zephyr/soc/cdns/xtensa_sample_controller/Kconfig.sysbuild"
osource "/Users/denislavtrifonov/work/projects/zephyr-data-logger/zephyr/soc/cdns/swerv/Kconfig.sysbuild"
osource "/Users/denislavtrifonov/work/projects/zephyr-data-logger/zephyr/soc/cdns/sample_controller32/Kconfig.sysbuild"
osource "/Users/denislavtrifonov/work/projects/zephyr-data-logger/zephyr/soc/cdns/dc233c/Kconfig.sysbuild"
osource "/Users/denislavtrifonov/work/projects/zephyr-data-logger/zephyr/soc/brcm/bcmvk/Kconfig.sysbuild"
osource "/Users/denislavtrifonov/work/projects/zephyr-data-logger/zephyr/soc/brcm/bcm2712/Kconfig.sysbuild"
osource "/Users/denislavtrifonov/work/projects/zephyr-data-logger/zephyr/soc/brcm/bcm2711/Kconfig.sysbuild"
osource "/Users/denislavtrifonov/work/projects/zephyr-data-logger/zephyr/soc/blackberry/qnxhv_vm/Kconfig.sysbuild"
osource "/Users/denislavtrifonov/work/projects/zephyr-data-logger/zephyr/soc/bflb/Kconfig.sysbuild"
osource "/Users/denislavtrifonov/work/projects/zephyr-data-logger/zephyr/soc/atmel/sam0/Kconfig.sysbuild"
osource "/Users/denislavtrifonov/work/projects/zephyr-data-logger/zephyr/soc/atmel/sam/Kconfig.sysbuild"
osource "/Users/denislavtrifonov/work/projects/zephyr-data-logger/zephyr/soc/aspeed/Kconfig.sysbuild"
osource "/Users/denislavtrifonov/work/projects/zephyr-data-logger/zephyr/soc/arm/Kconfig.sysbuild"
osource "/Users/denislavtrifonov/work/projects/zephyr-data-logger/zephyr/soc/arm/beetle/Kconfig.sysbuild"
osource "/Users/denislavtrifonov/work/projects/zephyr-data-logger/zephyr/soc/antmicro/myra/Kconfig.sysbuild"
osource "/Users/denislavtrifonov/work/projects/zephyr-data-logger/zephyr/soc/andestech/Kconfig.sysbuild"
osource "/Users/denislavtrifonov/work/projects/zephyr-data-logger/zephyr/soc/amd/acp_6_0/Kconfig.sysbuild"
osource "/Users/denislavtrifonov/work/projects/zephyr-data-logger/zephyr/soc/ambiq/Kconfig.sysbuild"
osource "/Users/denislavtrifonov/work/projects/zephyr-data-logger/zephyr/soc/allwinner/sun8i_h3/Kconfig.sysbuild"
osource "/Users/denislavtrifonov/work/projects/zephyr-data-logger/zephyr/soc/alif/ensemble/Kconfig.sysbuild"
osource "/Users/denislavtrifonov/work/projects/zephyr-data-logger/zephyr/soc/aesc/Kconfig.sysbuild"
osource "/Users/denislavtrifonov/work/projects/zephyr-data-logger/zephyr/soc/adi/max32/Kconfig.sysbuild"
```
